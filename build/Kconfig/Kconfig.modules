## build/Kconfig/Kconfig.modules
```kconfig
menu "hal_nordic (/home/david/Development/iot-project/zephyr/modules/hal/nordic)"
osource "$(ZEPHYR_HAL_NORDIC_KCONFIG)"
config ZEPHYR_HAL_NORDIC_MODULE
	bool
	default y
endmenu
menu "mbedtls (/home/david/Development/iot-project/zephyr/modules/crypto/mbedtls)"
osource "$(ZEPHYR_MBEDTLS_KCONFIG)"
config ZEPHYR_MBEDTLS_MODULE
	bool
	default y
endmenu
menu "sof (/home/david/Development/iot-project/zephyr/modules/audio/sof)"
osource "/home/david/Development/iot-project/zephyr/modules/audio/sof/zephyr/Kconfig"
config ZEPHYR_SOF_MODULE
	bool
	default y
endmenu
menu "TraceRecorder (/home/david/Development/iot-project/zephyr/modules/debug/TraceRecorder)"
osource "/home/david/Development/iot-project/zephyr/modules/debug/TraceRecorder/kernelports/Zephyr/Kconfig"
config ZEPHYR_TRACERECORDER_MODULE
	bool
	default y
endmenu
menu "trusted-firmware-m (/home/david/Development/iot-project/zephyr/modules/tee/tfm)"
osource "$(ZEPHYR_TRUSTED_FIRMWARE_M_KCONFIG)"
config ZEPHYR_TRUSTED_FIRMWARE_M_MODULE
	bool
	default y
endmenu
menu "nanopb (/home/david/Development/iot-project/zephyr/modules/lib/nanopb)"
osource "$(ZEPHYR_NANOPB_KCONFIG)"
config ZEPHYR_NANOPB_MODULE
	bool
	default y
endmenu
menu "tensorflow (/home/david/Development/iot-project/zephyr/modules/lib/tensorflow)"
osource "$(ZEPHYR_TENSORFLOW_KCONFIG)"
config ZEPHYR_TENSORFLOW_MODULE
	bool
	default y
endmenu
```

## build/Kconfig/Kconfig.shield
```kconfig
osource "/home/david/Development/iot-project/zephyr/zephyr/boards/shields/*/Kconfig.shield"
```

## build/Kconfig/Kconfig.shield.defconfig
```kconfig
osource "/home/david/Development/iot-project/zephyr/zephyr/boards/shields/*/Kconfig.defconfig"
```

## zephyr-app/basic_uart/build/Kconfig/Kconfig.soc.arch
```kconfig
osource "/home/david/Development/iot-project/zephyr/zephyr/soc/$(ARCH)/Kconfig"
osource "/home/david/Development/iot-project/zephyr/zephyr/soc/$(ARCH)/*/Kconfig"
```

## zephyr-app/build/Kconfig/Kconfig.shield.defconfig
```kconfig
osource "/home/david/Development/zephyr/zephyr/boards/shields/*/Kconfig.defconfig"
```

## zephyr-app/build/Kconfig/Kconfig.soc.arch
```kconfig
osource "/home/david/Development/zephyr/zephyr/soc/$(ARCH)/Kconfig"
osource "/home/david/Development/zephyr/zephyr/soc/$(ARCH)/*/Kconfig"
```

## zephyr-app/simple_i2c/build/Kconfig/Kconfig.soc
```kconfig
osource "/home/david/Development/iot-project/zephyr/zephyr/soc/$(ARCH)/*/Kconfig.soc"
```
